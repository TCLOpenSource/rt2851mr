## kernel/drivers/rtk_kdriver/Kconfig
```kconfig
menu "Realtek platform dependent drivers"

config RTK_KDRIVER_SUPPORT
    bool "RTK288O platform dependent drivers"
    default n
    depends on ARCH_RTK288O
    select RTK_KDRIVER
    ---help---

config RTK_KDRIVER
    bool
	depends on RTK_KDRIVER_SUPPORT
	default n

#Platform
source "drivers/rtk_kdriver/platform/Kconfig"

#PCBMGR
source "drivers/rtk_kdriver/pcbmgr/Kconfig"

#SCALER
source "drivers/rtk_kdriver/tvscalercontrol/Kconfig"

#HDMI RX
source "drivers/rtk_kdriver/tvscalercontrol/hdmirx/Kconfig"

# RTK_SEMAPHORE
config RTK_SEMAPHORE
	bool "Provide rtk_semaphore for RTK Semaphore"
	default y if !ARCH_RTK299O && !ARCH_RTK289X
	help
	  rtk_semaphore

config RTK_SEMAPHORE_TEST
	bool "Provide test case for RTK Semaphore"
	depends on RTK_SEMAPHORE
	default n

# AMP
# Please notice that this is only for REALTEK_AMP_TAS5711 & REALTEK_AMP_ACL1310
# If use different IC, please change this.
config RTK_KDRV_AMP
         bool "Do AMP_TAS5711 or ACL1310 init in kernel STR , if not,do not enable"
         default n
         help
          Amp initial

config RTK_AMP_USER_RESUME
	bool "do RTK Amp ACL1310 resume() in user resume flow"
	depends on RTK_KDRV_AMP
	default n if RTK_KDRV_AMP
	help
	  Amp resume() happen in user resume flow
#RPC
config RTK_KDRV_RPC
	bool "Use RPC to communicate with Audio & Video."
	default y
	help
	  Use RPC mechanism

# AVCPU
config RTK_KDRV_AVCPU
	bool "AVCPU Driver"
	default n
	help
	  Driver used to control Audio & Video cpu.

config RTK_KDRV_SUPPORT_ACPU2
	bool "Support ACPU2"
	depends on RTK_KDRV_AVCPU
	default n
	help
	  Enable ACPU2 support

config RTK_KDRV_SUPPORT_VCPU2
	bool "Support VCPU2"
	depends on RTK_KDRV_AVCPU
	default n
	help
	  Enable VCPU2 support

# EMCU
config RTK_KDRV_EMCU
	bool "EMCU Driver"
	default y
	help
	  Driver use to control EMCU in standby mode

choice 1
	prompt "Customer Parameter"
	depends on RTK_KDRV_EMCU
	default TV001_PLATFORM
	---help---
	  Select layout of share memory for customer

config TV001_PLATFORM
	bool "EMCU_TV001"
	---help---
	  for TV001 platform

config TV030_PLATFORM
	bool "EMCU_TV030"
	---help---
	  for TV030 platform

endchoice

config EMCU_AUTO_PARSER
	bool "EMCU driver auto parse pcb parameter"
	default n
	help
	  EMCU parse pcb parameter by self. It's need bootcode setting pcb param.

config RTK_KDRV_EMCU_DCOFF_TIMEOUT
	int "EMCU timeout to wait for WFIL2"
	default 3
	depends on RTK_KDRV_EMCU
	help
	  The second EMCU will wait for WFIL2, and then AC reboot.
	  Config as 0 will stop EMCU reboot, to keep for debugging.

# RTD LOGBUF
config REALTEK_LOGBUF
	bool "Realtek Logbuf"
	default n
	help
		Support Realtek Logbuf

# USBDUMP
config RTK_USBDUMP_ENABLE
        bool "Realtek usb dump enable"
	depends on REALTEK_LOGBUF
        default n
        help
                Support Realtek usbdump

# ONLINE-HLEP
config RTK_ONLINE_HELP
        bool "Realtek on-line help"
        default y
        help
                Support on-line help

# DDR
config RTK_DDR_SCAN
	bool "DDR Scan Driver"
	default y
	help
		Support DDR Scan Driver

# DDR Register Dump
config RTK_DDR_REG_DUMP
	bool "DDR Register Dump"
    depends on RTK_DDR_SCAN
	default y
	help
		Support DDR Register Dump

# SB2
config RTK_KDRV_SB2
	bool "SB2 Driver"
	depends on RTK_KDRIVER_SUPPORT
	select RTK_KDRIVER
	default n
	help
	  System Bridge II Driver

# GPIO
source "drivers/rtk_kdriver/gpio/Kconfig"

# LEDS
config RTK_KDRV_LEDS
        bool "Support LEDS Device"
        default y if RTK_LEDS_GPIO
        help
          Support LEDS Device

# PWM
config RTK_KDRV_PWM
	bool "PWM Driver"
	default n
	depends on RTK_KDRIVER_SUPPORT
	select RTK_KDRIVER
	help
	  PWM Device Driver

# I2C
source drivers/rtk_kdriver/i2c/Kconfig

# PCMCIA
config RTK_KDRV_PCMCIA
	bool "PCMCIA Driver"
	default n
	depends on RTK_KDRIVER_SUPPORT
	select RTK_KDRIVER
	select RTK_KDRV_GPIO
	help
	  PCMCIA Device Driver

# LG BOARD
config RTK_KDRV_LG_BOARD
        bool "LG BOARD arbiter to load one of the PCMCIA and smart card driver"
        default n
        depends on RTK_KDRIVER_SUPPORT
        select RTK_KDRIVER
        help
          LG BOARD arbiter to load one of the PCMCIA and smart card driver"


# MISC DRIVER INTERRUPT CONTROL CENTER
config RTK_KDRV_MISC_INTERRUPT
        bool "RTK KDRIVER MISC IP INTERRUPT CONTROL CENTER "
        default y
        help
          RTK kdriver MISC ip interrupt control center,if want to share MISC interrupt , please must enable this
		  
# LNB UART patch
config RTK_KDRV_LNB_UART
	bool "LG PCB LNB UART patch Driver"
	depends on RTK_KDRIVER_SUPPORT
	select RTK_KDRIVER
	default n
	help
	  LG PCB LNB UART patch Driver

# PINMUX
config RTK_KDRV_PINMUX
        bool "Pinmux Driver"
        default n
        depends on RTK_KDRIVER_SUPPORT
        select RTK_KDRIVER
        help
          Pinmux Driver

#Misc driver
config RTK_KDRV_MISC_DEV
	bool "Misc device Driver"
	default n
	depends on RTK_KDRIVER_SUPPORT
        select RTK_KDRIVER
        help
          Misc Driver

#ETN driver
config RTK_KDRV_R8168
	tristate "Realtek 8168 gigabit ethernet support"
	select FW_LOADER
	select CRC32
	select NET_CORE
	select MII
	select RTK_KDRIVER
	depends on ETHERNET
	depends on RTK_KDRIVER_SUPPORT
	default y if !ARCH_RTK289X
	---help---
	  Say Y here if you have a Realtek 8168 Gigabit Ethernet adapter.

	  To compile this driver as a module, choose M here: the module
	  will be called r8168.  This is recommended.

config RTK_KDRV_8168_EVENT
    	bool "Use kobject link down/up event"
	depends on RTK_KDRV_R8168
    	default n
    	help
      	  If you want to use kobject link down/up event, say Y.


source "drivers/rtk_kdriver/smartcard/Kconfig"
source "drivers/rtk_kdriver/cec/Kconfig"
source "drivers/rtk_kdriver/ddc/Kconfig"
source "drivers/rtk_kdriver/switch/Kconfig"

# OTP : One Time Programming memory
config RTK_KDRV_OTP
	bool "OTP Driver"
	depends on RTK_KDRIVER_SUPPORT
	select RTK_KDRIVER
	default n
	help
	  OTP (One Time Programming) Device

# OTP : Enable get HDCP key from OTP API
config RTK_KDRV_HDCP_KEY_FROM_OTP
	bool "Enable get HDCP key from OTP API"
	depends on RTK_KDRV_OTP
	default n
	help
	  get HDCP key from OTP API

# CW : Control Word
source "drivers/rtk_kdriver/cw/Kconfig"

# RNG : Random Number Generator
config RTK_KDRV_RNG
	bool "RNG (Random Number Generator) Driver."
	depends on RTK_KDRIVER_SUPPORT
	select RTK_KDRIVER
	default n
	help
	  provide HW Random number generator

# CP
source "drivers/rtk_kdriver/mcp/Kconfig"

# DV : Dolbyvision engine
config RTK_KDRV_DV
	bool "DV (Dolbyvision Engine) Driver."
	depends on RTK_KDRIVER_SUPPORT
	select RTK_KDRIVER
	default n
	help
	  Dolbyvision Engine

config DOLBY_IDK_1_6_1_1
	bool "Dolby Vision IDK 1.6.1.1"
	depends on RTK_KDRV_DV
	default n
	help
	  Dolbyvision Engine

config SUPPORT_DOLBY_VSIF
	bool "Dolby Vision HDMI SourceLed"
	depends on RTK_KDRV_DV
	default n
	help
	  Dolbyvision Engine
		   
config DOLBY_BACKLIGHT_CTRL_ADIM_PDIM
	bool "Dolby Vision Backlight Ctrl Adim/Pdim"
	depends on RTK_KDRV_DV
	default n
	help
	  Dolbyvision Backlight Control Adim and Pdim

# MD : Move data engine
config RTK_KDRV_MD
	bool "MD (Move Data Engine) Driver."
	depends on RTK_KDRIVER_SUPPORT
	select RTK_KDRIVER
	default n
	help
	  Move Data engine

# LSADC: Low-speed ADC
config RTK_KDRV_LSADC
	bool "LSADC (Low-speed ADC) Driver."
	depends on RTK_KDRIVER_SUPPORT
	select RTK_KDRIVER
	default y
	help
	  low speed ADC

# KEYPAD
config RTK_KDRV_KEYPAD
	bool "KeyPad Driver."
	depends on RTK_KDRV_LSADC && RTK_KDRV_GPIO
	default y
	help
	  Driver of Realtek use to control keypad

#SPI
config RTK_KDRV_SPI
  bool "SPI driver"
  depends on RTK_KDRIVER_SUPPORT
  default n
  help
    SPI feature support

config RTK_KDRV_SPI_MASTER_GENERAL
  bool "Realtek spi master controler general driver"
  depends on SPI_MASTER && !RTK_KDRV_SPI
  default n
  help
    Enables Realtek SPI controller driver.    

#RTC
config RTK_KDRV_RTC
	bool "RTC (Real-Time Clock Engine) Driver."
	depends on RTK_KDRIVER_SUPPORT
	select RTK_KDRIVER
	default n
	help
	  Real-Time Clock feature support

#Watch Dog
config RTK_KDRV_WATCHDOG
	bool "Watch Dog Driver."
	depends on RTK_KDRIVER_SUPPORT
	select RTK_KDRIVER
	default y
	help
	  Watch Dog feature support

#THERMAL
source "drivers/rtk_kdriver/thermal/Kconfig"

#CPU Frequency
config RTK_KDRV_CPU_FREQUENCY
	bool "CPU Frequency Driver"
	depends on RTK_KDRIVER_SUPPORT
	depends on CPU_FREQ
	select RTK_KDRIVER
	default y
	help
	  CPU Frequency

config PV88080_PMIC
	bool "USING PV88080 control power"
	depends on RTK_KDRV_CPU_FREQUENCY
	default n
	help
		SCPU DVS feature support

config REALTEK_ARM_WRAPPER
	bool "ARM WRAPPER Detector Enable"
	default n
	help
	  support ARM WRAPPER Detector

#Memory Trash Detecter
config RTK_KDRV_DC_MEMORY_TRASH_DETCTER
	bool "DCU Memory Trash Detector"
	depends on RTK_KDRIVER_SUPPORT
	select RTK_KDRIVER
	default n
	help
	  Memory Trash Detecter

#QoS Control
config RTK_KDRV_QOS_CONTROL
	bool "QoS Control"
	depends on RTK_KDRIVER_SUPPORT
	select RTK_KDRIVER
	default n
	help
	  QoS Control

#Watch point
config RTK_KDRV_WATCHPOINT
	bool "Simple Hardware Watchpoint"
	depends on HAVE_HW_BREAKPOINT
	default n
	help
	  Simple hardware watchpoint driver

#Frame Buffer
config RTK_KDRV_VENUS_FB
	tristate "RTK Frame Buffer Support"
	select FB
	select FB_CFB_FILLRECT
	select FB_CFB_COPYAREA
	select FB_CFB_IMAGEBLIT
	select FB_SOFT_CURSOR
	select MAGELLAN_CANVAS
	select SET_WIN_ALPHA_AS_FF
	default n
	help
	   Frame buffer driver for Realtek

#RTICE
source "drivers/rtk_kdriver/rtice/Kconfig"

#Voltage
config REALTEK_VOLTAGE_CTRL
	bool "SCPU voltage control"
	default n
	help
	  SCPU Voltage Control.

# IR
source "drivers/rtk_kdriver/ir/Kconfig"

#dccti
source "drivers/rtk_kdriver/dccti/Kconfig"

#ISR Debug
config RTK_KDEV_DEBUG_ISR
	bool "Handle Debug MEMC interrupt in SCPU"
	depends on RTK_KDRIVER_SUPPORT
	select RTK_KDRIVER
	default n
	help
		handle Debug MEMC interrupt in SCPU.

# RTK AI
config RTK_AI_DRV
        bool "ENABLE RTK AI SUPPORT"
        default n
        help
          Driver use to control rtk ai 
#USB HCD platform
source "drivers/rtk_kdriver/usb/Kconfig"

comment "DTV Related Drivers"

source "drivers/rtk_kdriver/demod/Kconfig"
source "drivers/rtk_kdriver/tp/Kconfig"
source "drivers/rtk_kdriver/delivery/Kconfig"
source "drivers/rtk_kdriver/japan4k_dmx/Kconfig"
source "drivers/rtk_kdriver/atsc3_dmx/Kconfig"
source "drivers/rtk_kdriver/atsc3_alp_dmx/Kconfig"
comment "HAL Drivers"

source "drivers/rtk_kdriver/demux/Kconfig"
source "drivers/rtk_kdriver/audio/Kconfig"
source "drivers/rtk_kdriver/vdec/Kconfig"
source "drivers/rtk_kdriver/teeproxy/Kconfig"
source "drivers/rtk_kdriver/audio_hw/Kconfig"
source "drivers/rtk_kdriver/crm/Kconfig"
source "drivers/rtk_kdriver/omx/Kconfig"

comment "GAL realted Drivers"
source "drivers/rtk_kdriver/gal/Kconfig"

comment "RTK Uart Drivers"
source "drivers/rtk_kdriver/uart/Kconfig"

comment "RTK Led Drivers"
source "drivers/rtk_kdriver/leds/Kconfig"

###################################################################
# DTV Related drivers
###################################################################

endmenu
```

## kernel/drivers/rtk_kdriver/ddc/Kconfig
```kconfig
config RTK_KDRV_DDC
	bool "Enable DDC"
	default n
	help
		DDC Platform Device Driver

config RTK_KDRV_DDC_SYSFS
	bool "DDC sysfs support"
	depends on RTK_KDRV_DDC
	default y
	help
		DDC Sysfs support
	
```

## kernel/drivers/rtk_kdriver/japan4k_dmx/Kconfig
```kconfig
config RTK_KDRV_JP4K
	bool "Enable Realtek JAPAN4k DMX Driver"
	depends on RTK_KDRV_TP
	default y if RTK_KDRV_TP
	help
	
```

## kernel/drivers/rtk_kdriver/leds/Kconfig
```kconfig
config RTK_KDRV_GPIO_LED
    bool "RTK_KDRV_GPIO_LED"
    depends on RTK_KDRV_LEDS
    default y
    help
        RTK GPIO LED

config RTK_KDRV_I2C_LED
    bool "RTK_KDRV_I2C_LED"
    default n
    help
        RTK GOOGLE VOICE i2c LED

config RTK_KDRV_SERIAL_LED
    bool "RTK_KDRV_SERIAL_LED"
    default n
    help
        RTK GOOGLE VOICE SERIAL LED
```

## kernel/drivers/rtk_kdriver/tvscalercontrol/Kconfig
```kconfig
config SUPPORT_SCALER
	bool "Scaler Driver"
	default y
	select RTK_HDMI_RX
	help
		SUPPORT Scaler Driver

config USE_SHARE_COMMON
    bool "Use Share Common"
    default n
    help
        SUPPORT New Common

config KDRIVER_USE_NEW_COMMON
    bool "Use New Common"
    default y
    help
        SUPPORT New Common

config HDCP2_USE_DEFAULT_HDCP_KEY
	bool "HDCP2 Use default HDCP Key"
	default n
	help
		Use default HDCP Key for bringup

if SUPPORT_SCALER
config SUPPORT_SRC_VGA
	bool "Support Source VGA"
	default y
	help
		SUPPORT Source VGA

config ENABLE_3D_SETTING
	bool "Enable VDC 3D YC Separation"
	default y
	help
		3D YC Separation

config DYNAMIC_ALLOCATION_SCALER_MEMORY
	bool "Enable dynamic memory allocation"
	default y
	help
		SUPPORT memory dynamic allocation

config DUAL_CHANNEL
	bool "Enable dual channel"
	default y
	help
		dual chanel open for pip


config ENABLE_VD_27MHZ_MODE
	bool "Enable VD 27MHz mode"
	default y
	help
		enable VD 27MHz mode

config FIX_CKILL_MODE
	bool "Fix ckill mode"
	default y
	help
		Fix ckill mode
endif

config RTK_KDRV_HDMI_ENABLE_V4L2
	bool "Enable HDMI V4L2 Support"
	default y
	help
	  Enable HDMI V4L2 Support


config MEMC
    bool "Enable MEMC"
    default n
    help
        Provide realtek MEMC.

config SUPPORT_SDR_MAX_RGB
	bool "support SDR max RGB"
	default n
	help
	  Enable support SDR max RGB		

config SUPPORT_IPQ
	bool "support IPQ"
	default y
	help
	  Enable support IPQ

config OSD_VALUE_NO_NEED_MAP_RANGE
	bool "OSD VALUE NO NEED MAP RANGE"
	default y
	help
	  Enable OSD VALUE NO NEED MAP RANGE	  
	  
```

## kernel/drivers/rtk_kdriver/usb/Kconfig
```kconfig
menu "RTK USB Driver"

config RTK_KDRV_USB
    bool "RTK USB driver support"
    depends on USB

if RTK_KDRV_USB

config RTK_KDRV_USB_CORE
    tristate "RTK USB CORE DRIVER SUPPORT"
    ---help---

config RTK_KDRV_XHCI_HCD_PLATFORM
    tristate "RTK XHCI HCD Platform support"
    depends on USB_XHCI_HCD
    ---help---

config RTK_KDRV_XHCI_SAVE_POWER_WHEN_NO_U3
    bool "Save power consumption when USB3.0 is not in use"
    depends on RTK_KDRV_XHCI_HCD_PLATFORM
    ---help---

config RTK_KDRV_EHCI_HCD_PLATFORM
    tristate "RTK EHCI HCD Platform support"
    depends on USB_EHCI_HCD
    ---help---

config RTK_KDRV_OHCI_HCD_PLATFORM
    tristate "RTK OHCI HCD Platform support"
    depends on USB_OHCI_HCD
    ---help---


config RTK_RESUME_SEQ_FOR_USB_DONGLE
    tristate "Put wifi dongle as the last resume device"
    depends on RTK_KDRV_USB
    ---help---

endif

endmenu
```

## kernel/drivers/tee/optee/Kconfig
```kconfig
# OP-TEE Trusted Execution Environment Configuration
config OPTEE
	tristate "OP-TEE"
	depends on HAVE_ARM_SMCCC
	depends on MMU
	help
	  This implements the OP-TEE Trusted Execution Environment (TEE)
	  driver.
config OPTEE_SECURE_SVP_PROTECTION
	tristate "SVP Protection"
	depends on OPTEE
	help
	  Set SVP Protection in OPTEE
```
