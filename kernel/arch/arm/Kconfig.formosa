## kernel/arch/arm/Kconfig.formosa
```kconfig
#
# Realtek Semiconductor Corp.
#
# RLX Linux Kernel Configuration
#
# Tony Wu (tonywu@realtek.com)
# Dec. 07, 2008
#

source "formosa/config.top"
source "formosa/config.soc"

#
# ARM
#
config SHEIPA
	bool
	default y
	select CPU_LITTLE_ENDIAN if SOC_CPU_EL
	select CPU_BIG_ENDIAN if SOC_CPU_EB
	select HW_HAS_PCI if SOC_ENABLE_PCI
	select HW_HAS_USB if SOC_ENABLE_USB
	select HAVE_ARM_SCU if SOC_ENABLE_IOCU
	select HAVE_SMP if SOC_ENABLE_SMP
	select SMP if SOC_ENABLE_SMP
	select VFP if SOC_ENABLE_VFP
	select NEON if SOC_ENABLE_NEON
	select CPU_HAS_L2C if SOC_ENABLE_L2C

#
# CPU
#
config CPU_ARMA5
	bool
	default y if SOC_CPU_ARMA5
	select CPU_V7
	select ARM_GIC
	select HAVE_ARM_TWD
	select HAVE_ARM_GLOBAL_TIMER

config CPU_ARMA7
	bool
	default y if SOC_CPU_ARMA7
	select CPU_V7
	select ARM_GIC
	select HAVE_ARM_ARCH_TIMER

config CPU_ARMA9
	bool
	default y if SOC_CPU_ARMA9
	select CPU_V7
	select ARM_GIC
	select HAVE_ARM_TWD
	select HAVE_ARM_GLOBAL_TIMER

config CPU_ARMA12
	bool
	default y if SOC_CPU_ARMA12
	select CPU_V7
	select ARM_GIC
	select HAVE_ARM_ARCH_TIMER

config CPU_ARMA15
	bool
	default y if SOC_CPU_ARMA15
	select CPU_V7
	select ARM_GIC
	select HAVE_ARM_ARCH_TIMER

config CPU_ARMA17
	bool
	default y if SOC_CPU_ARMA17
	select CPU_V7
	select ARM_GIC
	select HAVE_ARM_ARCH_TIMER

config CPU_ARMA53
	bool
	default y if SOC_CPU_ARMA53
	select CPU_V8
	select ARM_GIC
	select HAVE_ARM_ARCH_TIMER

config CPU_ARMA57
	bool
	default y if SOC_CPU_ARMA57
	select CPU_V8
	select ARM_GIC
	select HAVE_ARM_ARCH_TIMER

config CPU_ARMA57_A53
	bool
	default y if SOC_CPU_ARMA57_A53
	select CPU_V8
	select ARM_GIC
	select HAVE_ARM_ARCH_TIMER

config CPU_ARMA55
	bool
	default y if SOC_CPU_ARMA55
	select CPU_V8
	select ARM_GIC
	select ARM_GIC_V3
	select HAVE_ARM_ARCH_TIMER

config CPU_ARM926
	bool
	default y if SOC_CPU_ARM926
	select ARM_VIC

config CPU_ARM946
	bool
	default y if SOC_CPU_ARM946
	select ARM_VIC

#
# CACHE
#
config CPU_HAS_L2C
	bool

#
# BUS
#
config HW_HAS_USB
	bool

config HW_HAS_PCI
        bool
```

## kernel/arch/arm/mach-rtd285x/Kconfig
```kconfig
if ARCH_RTK285X

menu "RTK285X specific features"
	depends on ARCH_RTK285X

config REALTEK_FPGA
	bool "Support Realtek FPGA"
	default n

config REALTEK_SECURE
	bool "Enable Secure Solution"
	default n
	help
		Provide realtek secure solution.

config REALTEK_SECURE_DDK
	depends on REALTEK_SECURE
	bool "Enable Secure DDK"
	default n
	help
		Enable Secure DDK

config REALTEK_SECURE_OPENBSD
	depends on REALTEK_SECURE
	bool "Enable KCPU OPENBSD"
	default n
	help
		Enable KCPU run OPENBSD OS

config REALTEK_RESCUE_LINUX
	bool "Rescue Linux"
	default n

config REALTEK_POWER_CUT
        bool "Enable Realtek Power Cut"
        default n

config REALTEK_DEV_MEM
	bool "Provide the /dev/rtkmem interface."
	default n
	help
		Provide an interface to replace /dev/mem.

config REALTEK_MANAGE_OVERLAPPED_REGION
        bool "Manage the memory region overlapped by RBUS & NOR."
        default n
        help
          Put the memory region overlapped by RBUS & NOR under the control of linux.

config REALTEK_PCBMGR
	bool "Use Realtek PCB Manager sysfs"
	default n
	help
		pcb manager enable, pcb manager will export the pcb info at /sys/realtek_boards/pcb_enum

config REALTEK_ARM_WRAPPER
	bool "ARM WRAPPER Detector Enable"
	default y
	help
	  support ARM WRAPPER Detector

config REALTEK_KEYPAD
	bool "keypad"
	default n
	help
	  support keypad device

config MHL_INT_SUPPORT
	bool "Realtek MHL Cbus interrupt"
	default y

config REALTEK_SCHED_LOG
	bool "Log the scheduling sequence."
	default y
	help
	  Log the scheduling sequence.

config ANDROID_BY_PASS_MEMC
       bool "Disable MEMC for Android Merlin3 temporary"
       default n
       help
          Disable MEMC for Android merlin3 temporary

config REALTEK_UART2RBUS_CONTROL
	bool "Enable Realtek UART2RBUS control"
	default y
	help
	  Enable Realtek UART2RBUS control

config GPU_VOLTAGE_CONTROL
    bool "Enable GPU VOLTAGE in DFS"
    default n

config REALTEK_MEMORY_MANAGEMENT
        bool "Realtek memory management"
        default y
        help
         Code added for Realtek memory management

#Recovery kernel
config RTK_KDRV_RECOVERY_KERNEL
        bool "Build for android rescue kernel"
        default n
        help
          Android rescue kernel for Realtek

config RTK_ATF_BOOTING
        bool "Use ATF Bring up normal linux"
        default n
        help
          This option config trust Zone feature for normal OS


config IMG_DEMOD_CARVED_OUT_ADDRESS
       hex "notice, this carvedout not only for IxG's, but also for others."
       default 0x15400000 
       help
	this base is to defined carved out,
	and also used to setting hw remapping control.

endmenu

endif
```

## kernel/arch/arm64/configs/realtek/config.rescue.rtd287o64.optee.old_defconfig
```kconfig
CONFIG_CROSS_COMPILE="asdk64-linux-"
# CONFIG_LOCALVERSION_AUTO is not set
CONFIG_SYSVIPC=y
CONFIG_IRQ_DOMAIN_DEBUG=y
CONFIG_NO_HZ=y
CONFIG_HIGH_RES_TIMERS=y
CONFIG_BSD_PROCESS_ACCT=y
CONFIG_IKCONFIG=y
CONFIG_IKCONFIG_PROC=y
CONFIG_LOG_BUF_SHIFT=16
CONFIG_CGROUPS=y
CONFIG_CGROUP_FREEZER=y
CONFIG_BLK_DEV_INITRD=y
CONFIG_INITRAMFS_SOURCE="./rootfs"
CONFIG_INITRAMFS_ROOT_UID=16783985
CONFIG_INITRAMFS_ROOT_GID=16777729
# CONFIG_RD_BZIP2 is not set
# CONFIG_RD_LZMA is not set
# CONFIG_RD_XZ is not set
# CONFIG_RD_LZO is not set
# CONFIG_RD_LZ4 is not set
CONFIG_CC_OPTIMIZE_FOR_SIZE=y
CONFIG_KALLSYMS_ALL=y
CONFIG_EMBEDDED=y
CONFIG_MODULES=y
CONFIG_MODULE_FORCE_LOAD=y
CONFIG_MODULE_UNLOAD=y
CONFIG_MODULE_FORCE_UNLOAD=y
CONFIG_MODVERSIONS=y
CONFIG_MODULE_SRCVERSION_ALL=y
# CONFIG_BLK_DEV_BSG is not set
CONFIG_PARTITION_ADVANCED=y
CONFIG_ARCH_RTK287O=y
CONFIG_REALTEK_SECURE=y
# CONFIG_REALTEK_ARM_WRAPPER is not set
# CONFIG_REALTEK_SCHED_LOG is not set
# CONFIG_SUPPORT_SCALER is not set
# CONFIG_RTK_SEMAPHORE is not set
# CONFIG_RTK_KDRV_AMP is not set
# CONFIG_RTK_KDRV_RPC is not set
# CONFIG_RTK_KDRV_EMCU is not set
# CONFIG_RTK_ONLINE_HELP is not set
# CONFIG_RTK_KDRV_DDC is not set
# CONFIG_RTK_KDRV_WATCHDOG is not set
CONFIG_RTK_KDRV_SERIAL_8250=y
CONFIG_RTK_KDRV_SERIAL_8250_EXTENDED=y
CONFIG_RTK_KDRV_SERIAL_8250_CONSOLE=y
CONFIG_RTK_KDRV_SERIAL_8250_NR_UARTS=32
CONFIG_RTK_KDRV_SERIAL_8250_RUNTIME_UARTS=2
CONFIG_RTK_KDRV_SERIAL_8250_MANY_PORTS=y
CONFIG_RTK_KDRV_SERIAL_8250_SHARE_IRQ=y
CONFIG_RTK_KDRV_SERIAL_8250_DETECT_IRQ=y
CONFIG_RTK_KDRV_SERIAL_8250_RSA=y
CONFIG_NR_CPUS=4
CONFIG_PREEMPT=y
# CONFIG_COMPACTION is not set
CONFIG_CMA=y
CONFIG_CMA_DEBUGFS=y
CONFIG_CMDLINE="mem=256M console=ttyS0,115200 earlyprintk"
CONFIG_BINFMT_MISC=y
CONFIG_PM_DEBUG=y
CONFIG_NET=y
CONFIG_PACKET=y
CONFIG_UNIX=y
CONFIG_UNIX_DIAG=y
CONFIG_INET=y
CONFIG_IP_MULTICAST=y
CONFIG_IP_ADVANCED_ROUTER=y
CONFIG_IP_FIB_TRIE_STATS=y
CONFIG_IP_MULTIPLE_TABLES=y
CONFIG_IP_ROUTE_MULTIPATH=y
CONFIG_IP_PNP=y
CONFIG_NETWORK_SECMARK=y
CONFIG_BRIDGE=y
# CONFIG_WIRELESS is not set
CONFIG_DEVTMPFS=y
CONFIG_DEVTMPFS_MOUNT=y
CONFIG_DMA_CMA=y
# CONFIG_CMA_FIRST_POLICY is not set
CONFIG_MTD=y
CONFIG_REALTEK_OF=y
CONFIG_BLK_DEV_LOOP=y
CONFIG_BLK_DEV_RAM=y
CONFIG_BLK_DEV_RAM_SIZE=16384
CONFIG_SCSI=y
# CONFIG_SCSI_PROC_FS is not set
CONFIG_BLK_DEV_SD=y
CONFIG_CHR_DEV_SG=y
CONFIG_SCSI_SCAN_ASYNC=y
CONFIG_NETDEVICES=y
# CONFIG_NET_CADENCE is not set
# CONFIG_NET_VENDOR_BROADCOM is not set
# CONFIG_NET_VENDOR_INTEL is not set
# CONFIG_NET_VENDOR_MARVELL is not set
# CONFIG_NET_VENDOR_MICREL is not set
# CONFIG_NET_VENDOR_NATSEMI is not set
CONFIG_ETHOC=y
# CONFIG_NET_VENDOR_SMSC is not set
# CONFIG_NET_VENDOR_STMICRO is not set
# CONFIG_NET_VENDOR_WIZNET is not set
# CONFIG_WLAN is not set
CONFIG_INPUT_JOYDEV=y
CONFIG_INPUT_EVDEV=y
# CONFIG_INPUT_MOUSE is not set
CONFIG_INPUT_MISC=y
CONFIG_INPUT_UINPUT=y
# CONFIG_VT is not set
# CONFIG_LEGACY_PTYS is not set
# CONFIG_HW_RANDOM is not set
# CONFIG_I2C_COMPAT is not set
# CONFIG_I2C_HELPER_AUTO is not set
# CONFIG_HWMON is not set
CONFIG_REGULATOR=y
CONFIG_DRM=y
CONFIG_HIDRAW=y
CONFIG_STAGING=y
CONFIG_ASHMEM=y
CONFIG_MAILBOX=y
CONFIG_ANDROID=y
CONFIG_TEE=y
CONFIG_OPTEE=y
CONFIG_EXT2_FS=y
CONFIG_EXT4_FS=y
CONFIG_EXT4_FS_POSIX_ACL=y
CONFIG_EXT4_FS_SECURITY=y
CONFIG_MSDOS_FS=y
CONFIG_VFAT_FS=y
CONFIG_NTFS_FS=y
CONFIG_NTFS_RW=y
CONFIG_TMPFS=y
CONFIG_SQUASHFS=y
CONFIG_SQUASHFS_XATTR=y
CONFIG_SQUASHFS_LZO=y
CONFIG_SQUASHFS_XZ=y
CONFIG_SQUASHFS_4K_DEVBLK_SIZE=y
CONFIG_SQUASHFS_EMBEDDED=y
CONFIG_NFS_FS=y
CONFIG_NFS_V4=y
CONFIG_CIFS=y
# CONFIG_CIFS_DEBUG is not set
CONFIG_NLS_CODEPAGE_437=y
CONFIG_NLS_ISO8859_1=y
CONFIG_NLS_UTF8=y
CONFIG_PRINTK_TIME=y
CONFIG_DYNAMIC_DEBUG=y
CONFIG_DEBUG_INFO=y
CONFIG_DEBUG_FS=y
CONFIG_MAGIC_SYSRQ=y
CONFIG_SCHEDSTATS=y
CONFIG_DEBUG_MUTEXES=y
# CONFIG_FTRACE is not set
CONFIG_SECURITY=y
CONFIG_SECURITYFS=y
CONFIG_SECURITY_NETWORK=y
CONFIG_CRYPTO_CBC=y
CONFIG_CRYPTO_MICHAEL_MIC=y
CONFIG_CRYPTO_DEFLATE=y
CONFIG_CRYPTO_LZO=y
CONFIG_CRC_CCITT=y
CONFIG_CRC_T10DIF=y
CONFIG_CRC_ITU_T=y
CONFIG_CRC7=y
CONFIG_LIBCRC32C=y
```
